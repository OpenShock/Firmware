## components/captive_portal/Kconfig
```kconfig
menu "OpenShock captive portal"

    config OPENSHOCK_PORTAL_AP_IP
        string "SoftAP IPv4 address"
        default "4.3.2.1"
        help
            The fixed address the portal's SoftAP, DHCP server, DNS responder and captive
            portal API serve from, on a /24 network. Must be a dotted-decimal IPv4 address
            (checked at compile time).

    config OPENSHOCK_PORTAL_MAX_CLIENTS
        int "Clients (SoftAP stations and websockets)"
        range 1 8
        default 4
        help
            The SoftAP's station limit and the number of websocket clients the portal
            serves. Must stay below the HTTP server's socket count.

    config OPENSHOCK_PORTAL_HTTPD_MAX_SOCKETS
        int "HTTP server sockets"
        range 2 10
        default 8
        help
            Browsers open several connections per page load; with only 4 the LRU purge
            evicted the websocket (server push, so it looks idle). Also sizes the broadcast
            fd list. httpd needs 3 lwIP sockets besides these, and the DNS server, the
            gateway connection and an outbound HTTP request need one each (checked against
            LWIP_MAX_SOCKETS).

    config OPENSHOCK_PORTAL_HTTPD_TIMEOUT_MS
        int "HTTP socket send/receive timeout (ms)"
        range 1000 60000
        default 5000
        help
            Rounded up to whole seconds, the unit esp_http_server takes.

    config OPENSHOCK_PORTAL_WS_MAX_QUEUED_SENDS
        int "Queued websocket sends"
        range 4 256
        default 32
        help
            Outgoing websocket messages waiting for httpd. Bounds the memory a burst of
            broadcasts can hold while no client drains them; past it, new ones are dropped.

    config OPENSHOCK_PORTAL_STARTUP_GRACE_MS
        int "Startup grace period (ms)"
        range 0 600000
        default 30000
        help
            On a fully configured hub, how long after boot the portal waits for the gateway
            connection before it opens. It stays closed if the hub connects in time.

    config OPENSHOCK_PORTAL_AUTO_CLOSE_MS
        int "Auto-close delay (ms)"
        range 10000 3600000
        default 300000
        help
            Once the hub is online and no client is connected, the portal closes after this long.

endmenu
```

## components/captive_portal/Kconfig.openshock
```kconfig
# Sourced into the OpenShock menu by main/Kconfig.projbuild

menu "Captive portal"

    config OPENSHOCK_PORTAL_AP_IP
        string "SoftAP IPv4 address"
        default "4.3.2.1"
        help
            The fixed address the portal's SoftAP, DHCP server, DNS responder and captive
            portal API serve from, on a /24 network. Must be a dotted-decimal IPv4 address
            (checked at compile time).

    config OPENSHOCK_PORTAL_MAX_CLIENTS
        int "Clients (SoftAP stations and websockets)"
        range 1 8
        default 4
        help
            The SoftAP's station limit and the number of websocket clients the portal
            serves. Must stay below the HTTP server's socket count.

    config OPENSHOCK_PORTAL_HTTPD_MAX_SOCKETS
        int "HTTP server sockets"
        range 2 10
        default 8
        help
            Browsers open several connections per page load; with only 4 the LRU purge
            evicted the websocket (server push, so it looks idle). Also sizes the broadcast
            fd list. httpd needs 3 lwIP sockets besides these, and the DNS server, the
            gateway connection and an outbound HTTP request need one each (checked against
            LWIP_MAX_SOCKETS).

    config OPENSHOCK_PORTAL_HTTPD_STACK_SIZE
        int "HTTP server task stack (bytes)"
        range 4096 32768
        default 8192

    config OPENSHOCK_PORTAL_HTTPD_TIMEOUT_S
        int "HTTP socket send/receive timeout (s)"
        range 1 60
        default 5

    config OPENSHOCK_PORTAL_MAX_MESSAGE_SIZE
        int "Largest local websocket message (bytes)"
        range 1024 32768
        default 4096

    config OPENSHOCK_PORTAL_WS_MAX_QUEUED_SENDS
        int "Queued websocket sends"
        range 4 256
        default 32
        help
            Outgoing websocket messages waiting for httpd. Bounds the memory a burst of
            broadcasts can hold while no client drains them; past it, new ones are dropped.

    config OPENSHOCK_PORTAL_STARTUP_GRACE_S
        int "Startup grace period (s)"
        range 0 600
        default 30
        help
            On a fully configured hub, how long after boot the portal waits for the gateway
            connection before it opens. It stays closed if the hub connects in time.

    config OPENSHOCK_PORTAL_AUTO_CLOSE_S
        int "Auto-close delay (s)"
        range 10 3600
        default 300
        help
            Once the hub is online and no client is connected, the portal closes after this long.

    config OPENSHOCK_PORTAL_MANAGER_TASK_STACK_SIZE
        int "Portal manager task stack (bytes)"
        range 4096 16384
        default 6144

    config OPENSHOCK_PORTAL_ACCOUNT_LINK_TASK_STACK_SIZE
        int "Account link task stack (bytes)"
        range 4096 16384
        default 8192
        help
            Runs the HTTPS request that exchanges a link code for a token.

endmenu
```

## components/config/Kconfig.openshock
```kconfig
# Sourced into the OpenShock menu by main/Kconfig.projbuild

menu "Defaults"

    config OPENSHOCK_API_DOMAIN
        string "OpenShock API domain"
        default "api.openshock.app"
        help
            Default backend API domain the hub connects to. Overridable at runtime.

    config OPENSHOCK_FW_CDN_DOMAIN
        string "Firmware CDN domain"
        default "firmware.openshock.org"
        help
            Default CDN domain used for OTA firmware/version lookups. Overridable at runtime.

    config OPENSHOCK_FW_HOSTNAME
        string "Default hostname"
        default "OpenShock"
        help
            Default network hostname; also the base of the default user agent.

    config OPENSHOCK_FW_AP_PREFIX
        string "SoftAP SSID prefix"
        default "OpenShock-"
        help
            Prefix for the captive-portal SoftAP SSID (the device MAC is appended).

endmenu
```

## components/core/Kconfig
```kconfig
menu "OpenShock WiFi"

    config OPENSHOCK_WIFI_SCAN_MIN_MS_PER_CHANNEL
        int "Scan time per channel, minimum (ms)"
        range 10 1000
        default 60

    config OPENSHOCK_WIFI_SCAN_MAX_MS_PER_CHANNEL
        int "Scan time per channel, maximum (ms)"
        range OPENSHOCK_WIFI_SCAN_MIN_MS_PER_CHANNEL 1500
        default 120
        help
            At least the minimum. esp_wifi walks every channel itself, so this is the main
            knob for scan duration. Every scan takes the radio off the captive portal AP's
            channel for this long per channel, and portal clients lose frames meanwhile:
            keep it near the ESP-IDF default (120 ms).

    config OPENSHOCK_WIFI_AUTOSCAN_INTERVAL_MS
        int "Auto-scan interval when nothing to connect to (ms)"
        range 10000 3600000
        default 120000

    config OPENSHOCK_WIFI_CONNECT_BACKOFF_MAX_MS
        int "Connect retry backoff cap (ms)"
        range 2000 600000
        default 60000
        help
            A network that failed to connect is retried after 2 s, 4 s, 8 s, ... up to this.

    config OPENSHOCK_WIFI_POWERSAVE_IDLE_MS
        int "Radio stays awake after the last command (ms)"
        range 300000 86400000
        default 3600000
        help
            Modem sleep has the AP hold frames until the next DTIM beacon, delaying each one
            by up to a beacon interval (typically 100-300 ms). Power save is switched off on
            the first shocker command and back on after this long without one. The command
            handler reports activity at most once a minute; that minute is added on top, so the
            radio stays awake at least this long after the last command.

endmenu

menu "OpenShock gateway"

    config OPENSHOCK_GATEWAY_MAX_MESSAGE_SIZE
        int "Largest gateway message (bytes)"
        range 1024 32768
        default 4096

    config OPENSHOCK_GATEWAY_WS_BUFFER_SIZE
        int "Websocket buffer (bytes)"
        range 1024 OPENSHOCK_GATEWAY_MAX_MESSAGE_SIZE
        default 2048
        help
            esp_websocket_client allocates a receive and a send buffer of this size. A message
            larger than it arrives in pieces that are reassembled into a copy; one that fits is
            handled in place.

    config OPENSHOCK_GATEWAY_PING_TIMEOUT_MS
        int "Ping timeout (ms)"
        range 10000 600000
        default 90000
        help
            Reconnect when the gateway sent no ping for this long.

    config OPENSHOCK_GATEWAY_SEND_TIMEOUT_MS
        int "Send timeout (ms)"
        range 1000 60000
        default 10000

    config OPENSHOCK_GATEWAY_AUTH_RETRY_MS
        int "Retry after the backend rejected the token (ms)"
        range 10000 3600000
        default 300000

    config OPENSHOCK_GATEWAY_CONNECT_RETRY_MS
        int "Retry between gateway connection attempts, cap (ms)"
        range 1000 600000
        default 20000

    config OPENSHOCK_GATEWAY_CONNECT_RETRY_MIN_MS
        int "Retry between gateway connection attempts, first (ms)"
        range 1000 OPENSHOCK_GATEWAY_CONNECT_RETRY_MS
        default 2000
        help
            The delay before each connection attempt doubles from this up to the cap. It
            starts over once a connection has stayed up for the cap.

    config OPENSHOCK_GATEWAY_HUB_INFO_RETRY_MIN_MS
        int "Hub info fetch retry, first (ms)"
        range 1000 600000
        default 5000

    config OPENSHOCK_GATEWAY_HUB_INFO_RETRY_MAX_MS
        int "Hub info fetch retry, cap (ms)"
        range OPENSHOCK_GATEWAY_HUB_INFO_RETRY_MIN_MS 3600000
        default 300000
        help
            The retry after a failed hub info fetch doubles from the first value up to this.

endmenu

menu "OpenShock local messages"

    config OPENSHOCK_LOCAL_MAX_MESSAGE_SIZE
        int "Largest local message (bytes)"
        range 1024 32768
        default 4096
        help
            The largest message the local (captive portal websocket) message handler accepts.
            The portal drops a websocket message past this before buffering it.

endmenu
```

## components/core/Kconfig.openshock
```kconfig
# Sourced into the OpenShock menu by main/Kconfig.projbuild

menu "WiFi"

    config OPENSHOCK_WIFI_TASK_STACK_SIZE
        int "WiFi manager task stack (bytes)"
        range 2048 16384
        default 4096

    config OPENSHOCK_WIFI_TASK_PRIORITY
        int "WiFi manager task priority"
        range 1 24
        default 5

    config OPENSHOCK_WIFI_SCAN_MIN_MS_PER_CHANNEL
        int "Scan time per channel, minimum (ms)"
        range 10 1000
        default 60

    config OPENSHOCK_WIFI_SCAN_MAX_MS_PER_CHANNEL
        int "Scan time per channel, maximum (ms)"
        range 10 1500
        default 120
        help
            Must be at least the minimum. esp_wifi walks every channel itself, so this is
            the main knob for scan duration. Every scan takes the radio off the captive
            portal AP's channel for this long per channel, and portal clients lose frames
            meanwhile: keep it near the ESP-IDF default (120 ms).

    config OPENSHOCK_WIFI_AUTOSCAN_INTERVAL_MS
        int "Auto-scan interval when nothing to connect to (ms)"
        range 10000 3600000
        default 120000

    config OPENSHOCK_WIFI_CONNECT_BACKOFF_MAX_MS
        int "Connect retry backoff cap (ms)"
        range 2000 600000
        default 60000
        help
            A network that failed to connect is retried after 2 s, 4 s, 8 s, ... up to this.

endmenu

menu "Gateway"

    config OPENSHOCK_GATEWAY_TASK_STACK_SIZE
        int "Websocket client task stack (bytes)"
        range 4096 16384
        default 6144

    config OPENSHOCK_GATEWAY_MAX_MESSAGE_SIZE
        int "Largest gateway message (bytes)"
        range 1024 32768
        default 4096

    config OPENSHOCK_GATEWAY_PING_TIMEOUT_MS
        int "Ping timeout (ms)"
        range 10000 600000
        default 90000
        help
            Reconnect when the gateway sent no ping for this long.

    config OPENSHOCK_GATEWAY_SEND_TIMEOUT_MS
        int "Send timeout (ms)"
        range 1000 60000
        default 10000

    config OPENSHOCK_GATEWAY_AUTH_RETRY_MS
        int "Retry after the backend rejected the token (ms)"
        range 10000 3600000
        default 300000

    config OPENSHOCK_GATEWAY_CONNECT_RETRY_MS
        int "Retry between gateway connection attempts (ms)"
        range 1000 600000
        default 20000

    config OPENSHOCK_GATEWAY_HUB_INFO_RETRY_MIN_MS
        int "Hub info fetch retry, first (ms)"
        range 1000 600000
        default 5000

    config OPENSHOCK_GATEWAY_HUB_INFO_RETRY_MAX_MS
        int "Hub info fetch retry, cap (ms)"
        range 1000 3600000
        default 300000
        help
            The retry after a failed hub info fetch doubles from the first value up to this.

endmenu
```

## components/device_control/Kconfig
```kconfig
menu "OpenShock radio"

    config OPENSHOCK_RF_QUEUE_SIZE
        int "RF command queue length"
        range 8 256
        default 64
        help
            Commands waiting for the transmitter task. A full queue drops the command.

    config OPENSHOCK_RF_TERMINATOR_DURATION_MS
        int "Stop terminator duration (ms)"
        range 100 2000
        default 300
        help
            How long a finished command keeps sending its zero-intensity terminator, so
            the shocker stops even if it missed the last frames.

endmenu

menu "OpenShock keep-alive"

    config OPENSHOCK_KEEPALIVE_INTERVAL_MS
        int "Keep-alive interval (ms)"
        range 10000 600000
        default 60000
        help
            A shocker that saw no command for this long gets a short zero-intensity
            vibrate, so it doesn't go to sleep and miss the next command.

    config OPENSHOCK_KEEPALIVE_DURATION_MS
        int "Keep-alive command duration (ms)"
        range 100 2000
        default 300

    config OPENSHOCK_KEEPALIVE_MAX_SHOCKERS
        int "Shockers kept alive"
        range 1 64
        default 16
        help
            Shocker IDs come from the network, so the set is capped: past this, the least
            recently used shocker is dropped from it.

    config OPENSHOCK_KEEPALIVE_QUEUE_SIZE
        int "Keep-alive queue length"
        range 4 128
        default 32

endmenu

menu "OpenShock emergency stop"

    config OPENSHOCK_ESTOP_POLL_INTERVAL_MS
        int "Button poll interval (ms)"
        range 5 20
        default 5
        help
            How often the E-Stop task samples the button. The debounce time is fixed in
            code (65 ms); the number of samples it takes follows from this interval.
            At most 16 samples fit the debounce history, hence the 5 ms floor.

endmenu
```
