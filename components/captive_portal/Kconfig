## components/device_control/Kconfig.openshock
```kconfig
# Sourced into the OpenShock menu by main/Kconfig.projbuild

menu "Radio"

    config OPENSHOCK_RF_TASK_STACK_SIZE
        int "RF transmitter task stack (bytes)"
        range 2048 16384
        default 4096
        help
            Profiled at about 1.4 KB.

    config OPENSHOCK_RF_TASK_PRIORITY
        int "RF transmitter task priority"
        range 2 24
        default 9
        help
            Above the network tasks (5): it blocks on its queue or on RMT almost all the time,
            and frames (and the terminators after an E-Stop) shouldn't wait behind TLS work.
            Must stay above the WiFi manager and DNS server tasks, and below the E-Stop task's
            priority so a press preempts a transmission (checked at compile time).

    config OPENSHOCK_RF_QUEUE_SIZE
        int "RF command queue length"
        range 8 256
        default 64
        help
            Commands waiting for the transmitter task. A full queue drops the command.

    config OPENSHOCK_RF_TERMINATOR_DURATION_MS
        int "Stop terminator duration (ms)"
        range 100 2000
        default 300
        help
            How long a finished command keeps sending its zero-intensity terminator, so
            the shocker stops even if it missed the last frames.

endmenu

menu "Keep-alive"

    config OPENSHOCK_KEEPALIVE_INTERVAL_MS
        int "Keep-alive interval (ms)"
        range 10000 600000
        default 60000
        help
            A shocker that saw no command for this long gets a short zero-intensity
            vibrate, so it doesn't go to sleep and miss the next command.

    config OPENSHOCK_KEEPALIVE_DURATION_MS
        int "Keep-alive command duration (ms)"
        range 100 2000
        default 300

    config OPENSHOCK_KEEPALIVE_MAX_SHOCKERS
        int "Shockers kept alive"
        range 1 64
        default 16
        help
            Shocker IDs come from the network, so the set is capped: past this, the least
            recently used shocker is dropped from it.

    config OPENSHOCK_KEEPALIVE_QUEUE_SIZE
        int "Keep-alive queue length"
        range 4 128
        default 32

    config OPENSHOCK_KEEPALIVE_TASK_STACK_SIZE
        int "Keep-alive task stack (bytes)"
        range 2048 16384
        default 4096
        help
            Profiled at about 1.5 KB.

    config OPENSHOCK_KEEPALIVE_TASK_PRIORITY
        int "Keep-alive task priority"
        range 1 24
        default 1

endmenu

menu "Emergency stop"

    config OPENSHOCK_ESTOP_POLL_INTERVAL_MS
        int "Button poll interval (ms)"
        range 5 20
        default 5
        help
            How often the E-Stop task samples the button. The debounce time is fixed in
            code (65 ms); the number of samples it takes follows from this interval.
            At most 16 samples fit the debounce history, hence the 5 ms floor.

    config OPENSHOCK_ESTOP_TASK_STACK_SIZE
        int "E-Stop task stack (bytes)"
        range 2048 16384
        default 4096

    config OPENSHOCK_ESTOP_TASK_PRIORITY
        int "E-Stop task priority"
        range 3 24
        default 10
        help
            Above the network tasks (5) and the RF task: it is blocked almost all the time,
            and a sample that waits behind TLS work delays the E-Stop by that long. Must stay
            above the RF transmitter and DNS server tasks' priorities (checked at compile time).

endmenu
```

## components/diagnostics/Kconfig
```kconfig
menu "OpenShock Diagnostics"

    config OPENSHOCK_DIAG_LOG_BUFFER_SIZE
        int "Retained log size (bytes)"
        range 1024 16384
        default 4096
        help
            Log lines (errors always, more at a higher log upload level) are kept in a ring of
            this size in RAM that survives a software reset (panic, watchdog, restart), for
            upload once the owner enables it.

    config OPENSHOCK_DIAG_SDCARD
        bool "Store logs and crash dumps on an SD card"
        default n
        help
            Writes every log record and every crash dump to a microSD card in the raw format
            of docs/SDCARD.md (no filesystem), through ESP-IDF's sdmmc/sdspi drivers. For
            development and field-debugging builds; release builds leave it off.

            The pins below are Kconfig symbols, unlike the board pins (which come from the
            board descriptor). They exist only while this option is on, so a normal build's
            sdkconfig.h - and with it the shared build cache - is unaffected.

    if OPENSHOCK_DIAG_SDCARD

        choice OPENSHOCK_DIAG_SDCARD_BUS
            prompt "SD card bus"
            default OPENSHOCK_DIAG_SDCARD_BUS_SDMMC if SOC_SDMMC_USE_GPIO_MATRIX
            default OPENSHOCK_DIAG_SDCARD_BUS_SPI

            config OPENSHOCK_DIAG_SDCARD_BUS_SDMMC
                bool "SDMMC host (1- or 4-bit)"
                depends on SOC_SDMMC_USE_GPIO_MATRIX
                help
                    The chip's SD host controller, on any pins. Offered only where the host is
                    routed through the GPIO matrix (ESP32-S3): on the ESP32 its pins are fixed and
                    include strapping pins, so the ESP32 uses SPI mode.

            config OPENSHOCK_DIAG_SDCARD_BUS_SPI
                bool "SPI mode (SPI2)"
        endchoice

        if OPENSHOCK_DIAG_SDCARD_BUS_SDMMC

            config OPENSHOCK_DIAG_SDCARD_CLK_GPIO
                int "SD card CLK GPIO"
                default -1

            config OPENSHOCK_DIAG_SDCARD_CMD_GPIO
                int "SD card CMD GPIO"
                default -1

            config OPENSHOCK_DIAG_SDCARD_D0_GPIO
                int "SD card D0 GPIO"
                default -1

            config OPENSHOCK_DIAG_SDCARD_D1_GPIO
                int "SD card D1 GPIO (-1 for a 1-bit bus)"
                default -1

            config OPENSHOCK_DIAG_SDCARD_D2_GPIO
                int "SD card D2 GPIO (-1 for a 1-bit bus)"
                default -1

            config OPENSHOCK_DIAG_SDCARD_D3_GPIO
                int "SD card D3 GPIO (-1 for a 1-bit bus)"
                default -1
                help
                    With D3 set the bus runs 4-bit, and D1 and D2 must be set too.

        endif

        if OPENSHOCK_DIAG_SDCARD_BUS_SPI

            config OPENSHOCK_DIAG_SDCARD_SCK_GPIO
                int "SD card SCK GPIO"
                default -1

            config OPENSHOCK_DIAG_SDCARD_MOSI_GPIO
                int "SD card MOSI (CMD) GPIO"
                default -1

            config OPENSHOCK_DIAG_SDCARD_MISO_GPIO
                int "SD card MISO (DAT0) GPIO"
                default -1

            config OPENSHOCK_DIAG_SDCARD_CS_GPIO
                int "SD card CS (DAT3) GPIO"
                default -1

        endif

        config OPENSHOCK_DIAG_SDCARD_CD_GPIO
            int "SD card card-detect GPIO"
            default -1
            help
                Required: without card detect, removing the card can't be told apart from
                a dead card.

        config OPENSHOCK_DIAG_SDCARD_CD_ACTIVE_LOW
            bool "Card detect reads low when a card is inserted"
            default y

        config OPENSHOCK_DIAG_SDCARD_FREQ_KHZ
            int "SD card clock limit (kHz)"
            range 400 40000
            default 20000
            help
                The most the card is clocked at; the driver also stays within what the card
                reports. 40000 (high speed) needs a short, clean bus, and SDMMC.

        config OPENSHOCK_DIAG_SDCARD_QUEUE_SIZE
            int "Log record queue (bytes)"
            range 4096 65536
            default 16384
            help
                Records wait here for the card writer. When it is full, records are dropped
                and counted, never waited for.

    endif

endmenu
```

## components/dns_server/Kconfig.openshock
```kconfig
# Sourced into the OpenShock menu by main/Kconfig.projbuild

menu "Captive portal DNS server"

    config OPENSHOCK_DNS_TASK_STACK_SIZE
        int "DNS server task stack (bytes)"
        range 2048 8192
        default 3072

    config OPENSHOCK_DNS_TASK_PRIORITY
        int "DNS server task priority"
        range 1 24
        default 4
        help
            Above the other application tasks (1): a phone joining the AP sends a burst of
            DNS queries, and the small UDP receive mailbox drops them if this task is starved,
            which delays captive-portal detection by seconds. Keep it below httpd (5) and the
            E-Stop task.

endmenu
```

## components/http/Kconfig.openshock
```kconfig
# Sourced into the OpenShock menu by main/Kconfig.projbuild

menu "HTTP client"

    config OPENSHOCK_HTTP_BUFFER_SIZE
        int "Download buffer (bytes)"
        range 512 32768
        default 4096

    config OPENSHOCK_HTTP_MAX_STRING_RESPONSE_SIZE
        int "Largest response read into memory (bytes)"
        range 4096 262144
        default 65536
        help
            JSON and text responses are read whole; larger ones are rejected.

    config OPENSHOCK_HTTP_DOWNLOAD_SIZE_LIMIT_MB
        int "Largest streamed download (MB)"
        range 1 2000
        default 200

    config OPENSHOCK_HTTP_RETRY_AFTER_MIN_S
        int "Shortest Retry-After honoured (s)"
        range 1 600
        default 2
        help
            Also used when the header is missing or unparseable. Above zero, so a "0" can't
            turn into a tight retry loop.

    config OPENSHOCK_HTTP_RETRY_AFTER_MAX_S
        int "Longest Retry-After honoured (s)"
        range 1 86400
        default 600
        help
            So one bad header can't keep the hub offline for long.

endmenu
```

## components/led_drivers/Kconfig
```kconfig
menu "OpenShock LED drivers"

    config OPENSHOCK_RGB_LED_DITHERING
        bool "10-bit dithering on the RGB LED"
        default y
        help
            The WS2812B takes 8 bits per color. With dithering the driver shows 10: it sends
            4 frames that each round a channel to one of the two nearest 8-bit levels, and the
            RMT hardware repeats them on its own while the color holds, so the average lands
            on the quarter step in between at no CPU cost.

            The looped frames need several RMT memory blocks. Chips without a transmit channel
            to spare for the RF transmitter after that (ESP32-C3) round to 8 bits regardless.

            Off, each color is rounded to the nearest 8-bit level.

endmenu
```

## components/logging/Kconfig
```kconfig
menu "OpenShock logging"

    choice OPENSHOCK_LOG_LEVEL_CHOICE
        prompt "Log level"
        default OPENSHOCK_LOG_LEVEL_FROM_BUILD_MODE
        help
            Compile-time level of the OS_LOG* macros; anything below it is compiled out.

            By default it follows the build mode (scripts/gen_env_header.py: verbose for
            local and develop builds, debug for beta, info for stable). That value lives
            in openshock_board.h, not sdkconfig.h, so CI builds of every channel keep one
            sdkconfig.h and share their compiled ESP-IDF objects. Pick a level here to
            override it for a local build.

        config OPENSHOCK_LOG_LEVEL_FROM_BUILD_MODE
            bool "From the build mode"
        config OPENSHOCK_LOG_LEVEL_SET_NONE
            bool "None"
        config OPENSHOCK_LOG_LEVEL_SET_ERROR
            bool "Error"
        config OPENSHOCK_LOG_LEVEL_SET_WARN
            bool "Warning"
        config OPENSHOCK_LOG_LEVEL_SET_INFO
            bool "Info"
        config OPENSHOCK_LOG_LEVEL_SET_DEBUG
            bool "Debug"
        config OPENSHOCK_LOG_LEVEL_SET_VERBOSE
            bool "Verbose"
    endchoice

    config OPENSHOCK_LOG_LEVEL_OVERRIDE
        int
        default -1 if OPENSHOCK_LOG_LEVEL_FROM_BUILD_MODE
        default 0 if OPENSHOCK_LOG_LEVEL_SET_NONE
        default 1 if OPENSHOCK_LOG_LEVEL_SET_ERROR
        default 2 if OPENSHOCK_LOG_LEVEL_SET_WARN
        default 3 if OPENSHOCK_LOG_LEVEL_SET_INFO
        default 4 if OPENSHOCK_LOG_LEVEL_SET_DEBUG
        default 5 if OPENSHOCK_LOG_LEVEL_SET_VERBOSE

endmenu
```

## components/migration/Kconfig
```kconfig
menu "OpenShock partition layout migration"

    config OPENSHOCK_MIGRATION_TARGET_VERSION
        string "Firmware version to install after the layout migration"
        default "2.0.0"
        help
            The 1.9.x pivot release rewrites a hub's 1.x partition table into the 2.x layout (components/migration)
            and then installs this version, the first that assumes the 2.x layout.
            Its release must carry each board's partition-table.bin. Ignored by 2.x builds.

endmenu
```

## components/ota/Kconfig
```kconfig
menu "OpenShock OTA"

    config OPENSHOCK_OTA_GZIP
        bool "Try the gzip app image (the binary URL + .gz) first"
        default y
        help
            Decompressed with zlib (espressif/zlib), compressed with a 4 KB window. The decoder and its
            window are allocated before the downloads start; without the memory the plain image is
            downloaded instead.

    config OPENSHOCK_OTA_GZIP_MIN_FREE_BLOCK
        int "Largest free block to keep after allocating the gzip decoder (bytes)"
        range 16384 131072
        default 40960
        help
            The decoder is freed again, and the plain image downloaded, unless this much contiguous
            internal RAM is left for the TLS connections to the download host. Unused without
            OPENSHOCK_OTA_GZIP; not hidden behind it, so the decoder compiles either way.

endmenu
```

## components/rfc8908/Kconfig
```kconfig
menu "OpenShock captive portal detection"

    config OPENSHOCK_PORTAL_VENUE_INFO_URL
        string "Venue info URL"
        default "https://openshock.org"
        help
            The venue-info-url the RFC 8908 captive portal API reports; some phones offer
            it as a link next to the portal. Leave empty to leave it out.

endmenu
```

## components/serial/Kconfig
```kconfig
menu "OpenShock serial driver"

    config OPENSHOCK_SERIAL_RX_BUFFER_SIZE
        int "Console driver receive buffer (bytes)"
        range 256 4096
        default 256
        help
            The UART driver needs more than its 128-byte hardware FIFO.

    config OPENSHOCK_SERIAL_UART_TX_BUFFER_SIZE
        int "UART console transmit buffer (bytes)"
        range 256 16384
        default 2048

    config OPENSHOCK_SERIAL_USJ_TX_BUFFER_SIZE
        int "USB-Serial-JTAG console transmit buffer (bytes)"
        range 256 16384
        default 1024

endmenu
```

## components/serial/Kconfig.openshock
```kconfig
# Sourced into the OpenShock menu by main/Kconfig.projbuild

menu "Serial driver"

    config OPENSHOCK_SERIAL_RX_BUFFER_SIZE
        int "Console driver receive buffer (bytes)"
        range 128 4096
        default 256

    config OPENSHOCK_SERIAL_UART_TX_BUFFER_SIZE
        int "UART console transmit buffer (bytes)"
        range 256 16384
        default 2048

    config OPENSHOCK_SERIAL_USJ_TX_BUFFER_SIZE
        int "USB-Serial-JTAG console transmit buffer (bytes)"
        range 256 16384
        default 1024

endmenu
```

## components/serial_console/Kconfig
```kconfig
menu "OpenShock serial console"

    config OPENSHOCK_SERIAL_LINE_MAX_SIZE
        int "Longest input line (bytes)"
        range 256 16384
        default 4096
        help
            A longer line is discarded. rawconfig and jsonconfig take the whole config on
            one line, so this bounds the config the console can set.

endmenu
```
