## components/serial_console/Kconfig.openshock
```kconfig
# Sourced into the OpenShock menu by main/Kconfig.projbuild

menu "Serial console"

    config OPENSHOCK_SERIAL_RX_TASK_STACK_SIZE
        int "Serial input task stack (bytes)"
        range 4096 32768
        default 10000

    config OPENSHOCK_SERIAL_LINE_MAX_SIZE
        int "Longest input line (bytes)"
        range 256 16384
        default 4096
        help
            A longer line is discarded. rawconfig and jsonconfig take the whole config on
            one line, so this bounds the config the console can set.

endmenu
```
