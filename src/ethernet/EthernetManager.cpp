#include "ethernet/EthernetManager.h"

const char* const TAG = "EthernetManager";

#include "Logging.h"

#include <ESPmDNS.h>
#include <ETH.h>
#include <WiFi.h>

#include <atomic>
#include <cstdio>

using namespace OpenShock;

#ifndef OPENSHOCK_ETH_PHY_ADDR
#error "OPENSHOCK_ETH_PHY_ADDR must be defined for Ethernet builds"
#endif
#ifndef OPENSHOCK_ETH_PHY_POWER_GPIO
#error "OPENSHOCK_ETH_PHY_POWER_GPIO must be defined for Ethernet builds"
#endif
#ifndef OPENSHOCK_ETH_MDC_GPIO
#error "OPENSHOCK_ETH_MDC_GPIO must be defined for Ethernet builds"
#endif
#ifndef OPENSHOCK_ETH_MDIO_GPIO
#error "OPENSHOCK_ETH_MDIO_GPIO must be defined for Ethernet builds"
#endif

// PHY type + clock mode are enum identifiers, hardcoded here for the
// LAN8720 on an Olimex ESP32-PoE-style layout (PHY clock generated by
// ESP32 on GPIO17). Make these per-board when more ethernet variants land.
static constexpr eth_phy_type_t   kPhyType   = ETH_PHY_LAN8720;
static constexpr eth_clock_mode_t kClockMode = ETH_CLOCK_GPIO17_OUT;

static constexpr const char* kHostname = "openshock-test";

static std::atomic<bool> s_linkUp {false};
static std::atomic<bool> s_hasIp {false};
static std::atomic<bool> s_mdnsStarted {false};

static void startMdns()
{
  if (s_mdnsStarted.load()) {
    return;
  }
  if (!MDNS.begin(kHostname)) {
    OS_LOGW(TAG, "mDNS responder failed to start");
    return;
  }
  MDNS.setInstanceName("OpenShock Ethernet Test");
  MDNS.addService("http", "tcp", 80);
  s_mdnsStarted.store(true);
  OS_LOGI(TAG, "mDNS responder started: %s.local", kHostname);
}

static void onEthernetEvent(WiFiEvent_t event, WiFiEventInfo_t /*info*/)
{
  switch (event) {
    case ARDUINO_EVENT_ETH_START:
      OS_LOGI(TAG, "ETH start");
      ETH.setHostname(kHostname);
      break;
    case ARDUINO_EVENT_ETH_CONNECTED:
      OS_LOGI(TAG, "ETH link up: %s @ %u Mbps, %s-duplex", ETH.macAddress().c_str(), static_cast<unsigned>(ETH.linkSpeed()), ETH.fullDuplex() ? "full" : "half");
      s_linkUp.store(true);
      break;
    case ARDUINO_EVENT_ETH_GOT_IP: {
      IPAddress ip  = ETH.localIP();
      IPAddress nm  = ETH.subnetMask();
      IPAddress gw  = ETH.gatewayIP();
      OS_LOGI(TAG, "ETH got IP: %s  netmask=%s  gw=%s", ip.toString().c_str(), nm.toString().c_str(), gw.toString().c_str());
      s_hasIp.store(true);
      startMdns();
      break;
    }
    case ARDUINO_EVENT_ETH_DISCONNECTED:
      OS_LOGW(TAG, "ETH link down");
      s_linkUp.store(false);
      s_hasIp.store(false);
      break;
    case ARDUINO_EVENT_ETH_STOP:
      OS_LOGI(TAG, "ETH stopped");
      s_linkUp.store(false);
      s_hasIp.store(false);
      break;
    default:
      break;
  }
}

bool EthernetManager::Init()
{
  OS_LOGI(TAG, "Initializing Ethernet: phy=%d addr=%d mdc=%d mdio=%d power=%d clk_mode=%d", static_cast<int>(kPhyType), static_cast<int>(OPENSHOCK_ETH_PHY_ADDR), static_cast<int>(OPENSHOCK_ETH_MDC_GPIO), static_cast<int>(OPENSHOCK_ETH_MDIO_GPIO), static_cast<int>(OPENSHOCK_ETH_PHY_POWER_GPIO), static_cast<int>(kClockMode));

  WiFi.onEvent(onEthernetEvent);

  bool ok = ETH.begin(static_cast<uint8_t>(OPENSHOCK_ETH_PHY_ADDR), static_cast<int>(OPENSHOCK_ETH_PHY_POWER_GPIO), static_cast<int>(OPENSHOCK_ETH_MDC_GPIO), static_cast<int>(OPENSHOCK_ETH_MDIO_GPIO), kPhyType, kClockMode);
  if (!ok) {
    OS_LOGE(TAG, "ETH.begin() failed");
    return false;
  }

  OS_LOGI(TAG, "ETH.begin() returned OK; waiting for link and DHCP");
  return true;
}

bool EthernetManager::IsLinkUp()
{
  return s_linkUp.load();
}

bool EthernetManager::HasIPAddress()
{
  return s_hasIp.load();
}

bool EthernetManager::GetIPv4(char* out, std::size_t len)
{
  if (out == nullptr || len == 0 || !s_hasIp.load()) {
    return false;
  }
  IPAddress ip = ETH.localIP();
  int n        = std::snprintf(out, len, "%u.%u.%u.%u", ip[0], ip[1], ip[2], ip[3]);
  return n > 0 && static_cast<std::size_t>(n) < len;
}
